## conf/bblayers.conf.sample
```bitbake
# POKY_BBLAYERS_CONF_VERSION is increased each time build/conf/bblayers.conf
# changes incompatibly
POKY_BBLAYERS_CONF_VERSION = "2"

BBPATH = "${TOPDIR}"
BBFILES ?= ""

BBLAYERS ?= " \
  /home/build/yocto-sdk/poky/meta \
  /home/build/yocto-sdk/poky/meta-poky \
  /home/build/yocto-sdk/poky/meta-yocto-bsp \
  /home/build/yocto-sdk/meta-ecog \ 
  /home/build/yocto-sdk/meta-openembedded/meta-oe \
  /home/build/yocto-sdk/meta-openembedded/meta-python \
  /home/build/yocto-sdk/meta-openembedded/meta-filesystems \   
  /home/build/yocto-sdk/meta-openembedded/meta-networking \   
  /home/build/yocto-sdk/meta-openembedded/meta-initramfs \    
  /home/build/yocto-sdk/meta-virtualization \
  /home/build/yocto-sdk/meta-python2 \ 
  /home/build/yocto-sdk/meta-browser/meta-chromium \    
  /home/build/yocto-sdk/meta-clang \         
  /home/build/yocto-sdk/meta-mender/meta-mender-core \    
  "
```

## conf/layer.conf
```bitbake
# We have a conf and classes directory, add to BBPATH
BBPATH .= ":${LAYERDIR}"

# We have a recipes-* directories, add to BBFILES
BBFILES += "${LAYERDIR}/recipes-*/*/*.bb \
	${LAYERDIR}/recipes-*/*/*.bbappend"

BBFILE_COLLECTIONS += "meta-ecog"
BBFILE_PATTERN_meta-ecog = "^${LAYERDIR}/"
BBFILE_PRIORITY_meta-ecog = "5"
SANITY_BBLAYERCONF_SAMPLE ?= "${COREBASE}/meta-ecog/conf/bblayers.conf.sample"
SANITY_LOCALCONF_SAMPLE ?= "${COREBASE}/meta-ecog/conf/local.conf.sample"
LAYERSERIES_COMPAT_meta-ecog = "sumo thud warrior dunfell scarthgap"
WKS_FILES_PATH += "${LAYERDIR}/wic"

# python3-flit-core 3.12.0 (meta-ecog) provides flit_core>=3.11 needed by
# typing-extensions 4.15.0 and is bootstrapped using flit_core 3.9.0 native.
# python3-maturin 1.9.4 (meta-ecog) provides maturin>=1.9 needed by rpds-py 0.30.0.
# Uses Rust edition2021 (rust-version=1.74); Scarthgap ships Rust 1.75.0.
# python3-setuptools-rust 1.11.1 (meta-ecog) overrides OE-Core 1.10.1; maturin 1.9.4
# pyproject.toml requires setuptools-rust>=1.11.0.

# Pin versions that are lower than what OE-Core/scarthgap ships, so that
# the required version from the application requirements.txt is always used.
PREFERRED_VERSION_python3-websockets = "12.0"
```

## conf/machine/ecog-armv7.conf
```bitbake
#@TYPE: Machine
#@NAME: EcoG ARMv7 Emulated Machine
#@DESCRIPTION: Machine configuration for testing ocpppy on ARMv7 via QEMU

# Base it on the standard QEMU ARM configuration
require conf/machine/qemuarm.conf

DEFAULTTUNE = "armv7athf-neon"
```
